#include "ssd1306.h"
#include <string.h>
#include <stdlib.h>
#include "driver/i2c_master.h"
#include "esp_log.h"

#define TAG "ssd1306"
#define I2C_FREQ   400e3

static i2c_master_bus_handle_t s_bus;
static i2c_master_dev_handle_t s_dev;
static uint8_t  s_fb[OLED_WIDTH * OLED_ROWS]; /* 128 * 8 = 1024 bytes */
static int      s_col_off = OLED_COL_OFFSET;
static int      s_row_off = 0;

/* ---- 4×6 pixel font, ASCII 0x20–0x5A (uppercase only) --------------------
 * Row-major: each of the 6 bytes is one pixel row; bits 7-4 = columns 0-3.
 * Lowercase input is converted to uppercase in ssd1306_putchar.           */
#define FONT_W      4   /* glyph width  in pixels */
#define FONT_H      6   /* glyph height in pixels */
#define FONT_STRIDE 5   /* FONT_W + 1 spacing column */

static const uint8_t font4x6[][FONT_H] = {
/* bit7=col0, bit6=col1, bit5=col2, bit4=col3 */
    {0x00,0x00,0x00,0x00,0x00,0x00}, /* 0x20 ' ' */
    {0x40,0x40,0x40,0x00,0x40,0x00}, /* 0x21 '!' */
    {0xA0,0xA0,0x00,0x00,0x00,0x00}, /* 0x22 '"' */
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    {0xF0,0x10,0x20,0x40,0x80,0xF0}, /* 0x5A 'Z' */
};

/* ---- Low-level I2C helpers ----------------------------------------------- */

static void oled_write(const uint8_t *buf, size_t len)
{
    i2c_master_transmit(s_dev, buf, len, 100);
}

static void oled_cmd(uint8_t c)
{
    uint8_t buf[2] = {0x00, c};   /* control byte: Co=0, D/C#=0 → command */
    oled_write(buf, 2);
}

/* ---- Public API ---------------------------------------------------------- */

void ssd1306_init(int sda_pin, int scl_pin, uint8_t i2c_addr, int col_off, int row_off)
{
    i2c_master_bus_config_t bus_cfg = {
        .i2c_port          = I2C_NUM_0,
        .sda_io_num        = sda_pin,
        .scl_io_num        = scl_pin,
        .clk_source        = I2C_CLK_SRC_DEFAULT,
        .glitch_ignore_cnt = 7,
        .flags.enable_internal_pullup = true,
    };
    ESP_ERROR_CHECK(i2c_new_master_bus(&bus_cfg, &s_bus));

    i2c_device_config_t dev_cfg = {
        .dev_addr_length = I2C_ADDR_BIT_LEN_7,
        .device_address  = i2c_addr,
        .scl_speed_hz    = I2C_FREQ,
    };
    ESP_ERROR_CHECK(i2c_master_bus_add_device(s_bus, &dev_cfg, &s_dev));
    s_col_off = col_off;
    s_row_off = row_off;

    /* SSD1306 initialisation sequence */
    const uint8_t init_seq[] = {
        0xAE,                           /* display off */
        0xD5, 0x80,                     /* clock divide / oscillator freq */
        0xA8, (uint8_t)(OLED_HEIGHT-1), /* multiplex ratio */
        0xD3, (uint8_t)row_off,         /* display offset */
        (uint8_t)(0x40 | 0),            /* display start line: 0 */
        0x8D, 0x14,                     /* charge pump ON */
        0x20, 0x00,                     /* memory addressing: horizontal */
        0xA1,                           /* segment remap: col 127 → SEG0 (horizontal flip) */
        0xC8,                           /* COM scan direction: reversed (vertical flip) */
        0xDA, (OLED_HEIGHT > 32 ? (uint8_t)0x12 : (uint8_t)0x02), /* COM pins */
        0x81, 0xCF,                     /* contrast */
        0xD9, 0xF1,                     /* precharge period */
        0xDB, 0x40,                     /* VCOM deselect level */
        0xA4,                           /* resume to RAM content */
        0xA6,                           /* normal (non-inverted) display */
        0xAF,                           /* display on */
    };
    for (size_t i = 0; i < sizeof(init_seq); i++)
        oled_cmd(init_seq[i]);

    ssd1306_clear();
    ssd1306_flush();
}

void ssd1306_clear(void)
{
    memset(s_fb, 0, sizeof(s_fb));
}

void ssd1306_clear_row(int row)
{
    if (row < 0 || row >= OLED_ROWS) return;
    memset(&s_fb[row * OLED_WIDTH], 0, OLED_WIDTH);
}

void ssd1306_flush(void)
{
    uint8_t buf[OLED_WIDTH + 1];
    buf[0] = 0x40; /* data stream */
    for (int page = 0; page < OLED_ROWS; page++) {
        oled_cmd(0xB0 | page);
        oled_cmd(0x00 | (s_col_off & 0x0F));
        oled_cmd(0x10 | ((s_col_off >> 4) & 0x0F));
        memcpy(buf + 1, &s_fb[page * OLED_WIDTH], OLED_WIDTH);
        oled_write(buf, OLED_WIDTH + 1);
    }
}

void ssd1306_putchar(int col, int row, char c)
{
    if (col < 0 || col >= OLED_COLS || row < 0 || row >= OLED_ROWS) return;
    if (c >= 'a' && c <= 'z') c -= 32;
    if (c < 0x20 || c > 0x5A) c = '?';
    const uint8_t *glyph = font4x6[(uint8_t)c - 0x20];

    int base = row * OLED_WIDTH + col * FONT_STRIDE;
    for (int x = 0; x < FONT_W; x++) {
        uint8_t col_byte = 0;
        for (int y = 0; y < FONT_H; y++) {
            if (glyph[y] & (0x80 >> x))
                col_byte |= (1 << y);
        }
        s_fb[base + x] = col_byte;
    }
    s_fb[base + FONT_W] = 0; /* spacing column */
}

void ssd1306_puts(int col, int row, const char *s)
{
    while (*s && col < OLED_COLS) {
        ssd1306_putchar(col++, row, *s++);
    }
}

void ssd1306_power(bool on)
{
    oled_cmd(on ? 0xAF : 0xAE);
}
